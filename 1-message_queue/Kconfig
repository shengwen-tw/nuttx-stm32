## 1-message_queue/Kconfig
```kconfig
config EXAMPLES_NUTTX_STM32_MQUEUE
	bool "NuttX STM32 Message Queue Example"
	default n
	---help---
		Enable NuttX STM32 Message Queue Example

if EXAMPLES_NUTTX_STM32_MQUEUE

endif
```

## 2-semaphore/Kconfig
```kconfig
config EXAMPLES_NUTTX_STM32_SEMAPHORE
	bool "NuttX STM32 Semaphore Example"
	default n
	---help---
		Enable NuttX STM32 Semaphore Example

if EXAMPLES_NUTTX_STM32_SEMAPHORE

endif
```

## 4-mpu6500/Kconfig
```kconfig
config SENSORS_MPU6500
        bool "MPU6500 6-axis Inertial Measurement Unit"
        default n
        select I2C
        ---help---
                Enable driver support for MPU6500 Inertial Measurement Unit (IMU).
```

## message_queue/Kconfig
```kconfig
config EXAMPLES_MY_APP
	bool "My First NuttX Application"
	default n
	---help---
		Enable my first NuttX application

if EXAMPLES_MY_APP

endif
```

## work_queue/Kconfig
```kconfig
config EXAMPLES_NUTTX_STM32_WQ
	bool "NuttX Work Queue Example"
	default n
	---help---
		Enable Nuttx STM32 Work Queue Example

if EXAMPLES_NUTTX_STM32_WQ

endif
```
